#include "dragon.dtsi"  // Notice that the main dtsi files are included in the overlay.

&kscan0 {
    row-gpios
	= <&pro_micro_d 5 (GPIO_ACTIVE_HIGH)>
	, <&pro_micro_d 6 (GPIO_ACTIVE_HIGH)>
	, <&pro_micro_d 7 (GPIO_ACTIVE_HIGH)>
	, <&pro_micro_a 8 (GPIO_ACTIVE_HIGH)>
	, <&pro_micro_a 9 (GPIO_ACTIVE_HIGH)>
	;

    // row-gpios
    // = <&pro_micro_d 5 (GPIO_ACTIVE_HIGH | GPIO_PULL_DOWN)>
    // , <&pro_micro_d 6 (GPIO_ACTIVE_HIGH | GPIO_PULL_DOWN)>
    // , <&pro_micro_d 7 (GPIO_ACTIVE_HIGH | GPIO_PULL_DOWN)>
    // , <&pro_micro_a 8 (GPIO_ACTIVE_HIGH | GPIO_PULL_DOWN)>
    // , <&pro_micro_a 9 (GPIO_ACTIVE_HIGH | GPIO_PULL_DOWN)>
    // ;

	// col-gpios 
	// 	= <&pro_micro_a  1 GPIO_ACTIVE_HIGH>
	// 	, <&pro_micro_a  0 GPIO_ACTIVE_HIGH>
	// 	, <&pro_micro_d 15 GPIO_ACTIVE_HIGH>
	// 	, <&pro_micro_d 14 GPIO_ACTIVE_HIGH>
	// 	, <&pro_micro_d 16 GPIO_ACTIVE_HIGH>
	// 	, <&pro_micro_d 10 GPIO_ACTIVE_HIGH>
	// 	;

    
};