## config/boards/shields/adafruit_macropad/Kconfig.defconfig
```kconfig
# CONFIG_ZMK_DISPLAY=y
# CONFIG_LVGL_USE_THEME_MONO=y
# CONFIG_LVGL_COLOR_TRANSP_CUSTOM=y
# CONFIG_LVGL_CUSTOM_COLOR_TRANSP_RED=0x00
# CONFIG_LVGL_CUSTOM_COLOR_TRANSP_GREEN=0x00
# CONFIG_LVGL_CUSTOM_COLOR_TRANSP_BLUE=0x00

if ADAFRUIT_MACROPAD


config ZMK_KEYBOARD_NAME
    default "ada_macropad"


# config ZMK_DISPLAY
# 	select LVGL_USE_CONT
# 	select LVGL_FONT_MONTSERRAT_26

    # choice ZMK_DISPLAY_STATUS_SCREEN
    #     default ZMK_DISPLAY_STATUS_SCREEN_BUILT_IN
    # endchoice

# choice ZMK_DISPLAY_STATUS_SCREEN
# 	select ZMK_DISPLAY_STATUS_SCREEN_BUILT_IN


# choice ZMK_DISPLAY_STATUS_SCREEN_BUILT_IN
# endchoice


# if ZMK_DISPLAY

# choice LVGL_THEME_DEFAULT_FONT_NORMAL
#     default LVGL_THEME_DEFAULT_FONT_NORMAL_MONTSERRAT_26

# endchoice

# choice LVGL_THEME_DEFAULT_FONT_SMALL
#     default LVGL_THEME_DEFAULT_FONT_SMALL_MONTSERRAT_26

# endchoice


# config LVGL_HOR_RES_MAX
# 	default 144

# config LVGL_VER_RES_MAX
# 	default 168

# config SPI
# 	default y

# config LS0XX
# 	default y

# config LVGL_BITS_PER_PIXEL
# 	default 1

# choice LVGL_COLOR_DEPTH
# 	default LVGL_COLOR_DEPTH_1

# endchoice

# config LVGL_DPI
# 	default 30

# config LVGL_VDB_SIZE
# 	default 16

# endif # ZMK_DISPLAY




endif
```

## config/boards/shields/adafruit_macropad/Kconfig.shield
```kconfig
config ADAFRUIT_MACROPAD
    def_bool $(shields_list_contains,adafruit_macropad)
```

## config/boards/shields/dayctal/Kconfig.defconfig
```kconfig
if DAYCTAL_LEFT

config ZMK_KEYBOARD_NAME
    default "Dayctal"

config ZMK_SPLIT_ROLE_CENTRAL
    default y

endif

if DAYCTAL_LEFT || DAYCTAL_RIGHT

config ZMK_SPLIT
    default y

endif
```

## config/boards/shields/dayctal/Kconfig.shield
```kconfig
config DAYCTAL_LEFT
    def_bool $(shields_list_contains,dayctal_left)

config DAYCTAL_RIGHT
    def_bool $(shields_list_contains,dayctal_right)
```

## config/boards/shields/dragon/Kconfig.defconfig
```kconfig
if SHIELD_DRAGON_LEFT

config ZMK_KEYBOARD_NAME
    default "Dragon Left"

config ZMK_SPLIT_BLE_ROLE_CENTRAL
    default y
endif

if SHIELD_DRAGON_RIGHT

config ZMK_KEYBOARD_NAME
    default "Dragon Right"

endif

if SHIELD_DRAGON_LEFT || SHIELD_DRAGON_RIGHT

config ZMK_SPLIT
    default y

endif
```

## config/boards/shields/dragon/Kconfig.shield
```kconfig
config SHIELD_DRAGON_LEFT
    def_bool $(shields_list_contains,dragon_left)

config SHIELD_DRAGON_RIGHT
    def_bool $(shields_list_contains,dragon_right)
```
