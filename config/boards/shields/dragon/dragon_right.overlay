// Dragon

#include "dragon.dtsi"

&default_transform {
	col-offset = <6>;
};

&kscan0 {



	row-gpios
	= <&pro_micro_d 5 (GPIO_ACTIVE_HIGH)>
	, <&pro_micro_d 6 (GPIO_ACTIVE_HIGH)>
	, <&pro_micro_d 7 (GPIO_ACTIVE_HIGH)>
	, <&pro_micro_a 8 (GPIO_ACTIVE_HIGH)>
	, <&pro_micro_a 9 (GPIO_ACTIVE_HIGH)>
	;

};